## config/boards/shields/rawb/Kconfig.defconfig
```kconfig
if SHIELD_RAWB

config ZMK_KEYBOARD_NAME
    default "rawb"

endif

if SHIELD_RAWB

config ZMK_SPLIT
    default n

if ZMK_DISPLAY

config I2C
    default y

config ssd1306
    default y

endif

endif
```
